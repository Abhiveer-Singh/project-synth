## work/build/Kconfig/arch/Kconfig
```kconfig
# Load Zephyr Arch Kconfig descriptions.
osource "/home/halo/zephyrproject/zephyr/arch/x86/Kconfig"
osource "/home/halo/zephyrproject/zephyr/arch/xtensa/Kconfig"
osource "/home/halo/zephyrproject/zephyr/arch/sparc/Kconfig"
osource "/home/halo/zephyrproject/zephyr/arch/riscv/Kconfig"
osource "/home/halo/zephyrproject/zephyr/arch/posix/Kconfig"
osource "/home/halo/zephyrproject/zephyr/arch/nios2/Kconfig"
osource "/home/halo/zephyrproject/zephyr/arch/mips/Kconfig"
osource "/home/halo/zephyrproject/zephyr/arch/arm64/Kconfig"
osource "/home/halo/zephyrproject/zephyr/arch/arm/Kconfig"
osource "/home/halo/zephyrproject/zephyr/arch/arc/Kconfig"
```

## work/build/Kconfig/boards/Kconfig
```kconfig
# Load Zephyr board Kconfig descriptions.
osource "/home/halo/zephyrproject/zephyr/boards/st/nucleo_f446re/Kconfig"
```

## work/build/Kconfig/boards/Kconfig.defconfig
```kconfig
# Load Zephyr board defconfig descriptions.
osource "/home/halo/zephyrproject/zephyr/boards/st/nucleo_f446re/Kconfig.defconfig"
```

## work/build/Kconfig/boards/Kconfig.nucleo_f446re
```kconfig
# Load board Kconfig descriptions.
osource "/home/halo/zephyrproject/zephyr/boards/st/nucleo_f446re/Kconfig.nucleo_f446re"
```

## work/build/Kconfig/boards/Kconfig.sysbuild
```kconfig
# Load Sysbuild board Kconfig descriptions.
osource "/home/halo/zephyrproject/zephyr/boards/st/nucleo_f446re/Kconfig.sysbuild"
```
